## boot/vendor/kshim/src/Kconfig
```kconfig
mainmenu "kShimC $(VERSION) Configuration"

config KSHIM_EXT4_BOOT
    bool "OnePlus Pad 2 Pro external ext4 Linux boot (experimental)"
    select KSHIM_UFS_NATIVE_IO
    select KSHIM_UFS_LINK_WAKE
    select KSHIM_UFS_DEVICE_WAKE
    default n
    help
        Adds an explicit ext4 file source to the existing menu. Android and
        memory payload selection perform no external-storage IO. Qualcomm
        UFS is admitted only with verified inherited identity DMA mappings.

config KSHIM_BOOT_PARTUUID
    string "External boot GPT partition UUID (canonical lowercase)"
    depends on KSHIM_EXT4_BOOT
    default ""

config KSHIM_BOOT_PARTLABEL
    string "GPT name for explicit discovery when UUID is empty"
    depends on KSHIM_EXT4_BOOT
    default "linux_boot"

config KSHIM_STORAGE_ENTRY_PROBE
    bool "Capture read-only TB322FC/TB323FU UFS/SMMU entry state"
    default n
    help
        Diagnostic only. Reads a bounded register whitelist on an actual
        TB322FC or TB323FU at EL1 with the early MMU enabled, then exports
        it to the selected Linux tree. Does not initialize storage or submit
        DMA. A precise synchronous read abort can be reported; a bus lockup
        or asynchronous error still requires physical recovery.

config KSHIM_UFS_NATIVE_IO
    bool "Expose bounded native UFS MMIO/DMA-memory primitives"
    default n
    help
        Adds a bounded register writer plus CPU mapping and
        cache helpers for the native UFS IO profile. It performs no disk
        operation and neither claims the controller nor owns DMA mappings;
        the caller must supply an isolated arena and prove the live SMMU.

config KSHIM_UFS_READ_PROBE
    bool "One-shot read-only native UFS read diagnostic"
    depends on KSHIM_STORAGE_ENTRY_PROBE && KSHIM_UFS_NATIVE_IO
    default n
    help
        Diagnostic only. Runs the validated read-only sequence once at boot
        entry on an actual TB322FC or TB323FU: LUN 0 capacity, a backup-GPT
        lookup and one header/tail block read. It claims and releases the
        firmware queues and writes no disk, SMMU or clock register. A release
        failure halts before any payload handoff.

config KSHIM_UFS_READ_SCREEN
    bool "Show early UFS read diagnostics on the scanout"
    depends on KSHIM_UFS_READ_PROBE && KSHIM_FRAMEBUFFER
    default n
    help
        Diagnostic only. Paints the last operation of the one-shot read-only
        UFS sequence into the top strip of the live scanout on an actual
        TB322FC, starting immediately before the capture. It reuses the
        read-only splash parser and the existing MMU mapping for the scanout
        span, never reinitialises the display controller, never writes to the
        disk and stores nothing outside that strip. The storage IO order,
        report layout and unsafe-release halt are unchanged.

config KSHIM_UFS_LINK_WAKE
    bool "Manage inherited UFS link power"
    depends on KSHIM_UFS_NATIVE_IO
    default n
    help
        Native transactions query the MPHY TX
        FSM state the firmware left behind and, when the link is HIBERN8,
        exits it before the first command and restores the entry state on
        release. No HCE/reset, clock, SMMU or disk write is issued. The
        bounded native writer accepts the exact UIC command/argument pairs
        this sequence needs only while this option is enabled.

config KSHIM_UFS_DEVICE_WAKE
    bool "Resume inherited UFS device power"
    depends on KSHIM_UFS_NATIVE_IO && KSHIM_UFS_LINK_WAKE
    default n
    help
        Query the device power mode after the link is ready. Wake only a
        confirmed SLEEP or POWERDOWN device, and verify its ACTIVE mode
        before accessing LUN 0. Restore and verify the original mode before
        returning the link and queues to firmware. No disk data is written;
        an unverified restore prevents payload handoff.

config KSHIM_UFS_SETTINGS
    bool "Persist launcher settings in provisioned internal UFS backup space"
    depends on KSHIM_UFS_NATIVE_IO && KSHIM_UFS_LINK_WAKE && KSHIM_UFS_DEVICE_WAKE
    default n
    help
        Load and save only an existing v3 settings region on the actual board.
        Each transaction reclaims and restores the firmware controller state.
        Old or unprovisioned backups are never formatted by the launcher.

config KSHIM_SETTINGS_SAVE_TEST
    bool "Gen4 test: seed an EMPTY provisioned settings store with internal Linux"
    depends on KSHIM_UFS_SETTINGS
    default n
    help
        Explicit hardware write-test profile. Only an existing EMPTY Gen4
        settings pair is written, once, with AUTO/internal Linux/Chinese.
        Existing settings and unprovisioned backups are left untouched.

config KSHIM_TB323FU_ANDROID_TOUCH_4M8
    bool "Preserve TB323FU Android touch SPI compatibility"
    default n
    help
        Keep the original Android NVT controller at 4.8 MHz on TB323FU.
        Applies only to the detected board's original Android device tree;
        does not enable touch input in the launcher or change Linux trees.

config KSHIM_BOOT_TIMING
    bool "Record boot stages in the selected Linux device tree"
    default n

config KSHIM_QCOM_REBOOT
    bool "DT-selected Qualcomm recovery, bootloader and EDL targets"
    depends on QCOM_SPMI
    default n

config KSHIM_EDL_DISABLE_SDI
    bool "Disable SDI before Qualcomm EDL reset"
    depends on KSHIM_QCOM_REBOOT
    default n
    help
        Disable watchdog debug and SDI before EDL reset on TB322FC and
        TB323FU. Firmware support is checked before changing the download
        cookie; preparation failure restores its previous value.

config KSHIM_EDL_PROBE
    bool "Report read-only Qualcomm EDL reset capabilities to Linux"
    depends on KSHIM_QCOM_REBOOT && KSHIM_UFS_SETTINGS
    default n
    help
        Diagnostic only. Query the existing reset paths and read the DT-selected
        download cookie before the menu. Export results to the Linux device tree;
        do not change cookies, settings, reset selection or invoke a reset.

config KSHIM_MENU_ADVANCED_ACTIONS
    bool "Group diagnostic and recovery targets in an advanced menu"
    depends on KSHIM_QCOM_REBOOT
    default n

menu "Architecture"
    source "$srctree/arch/Kconfig"
endmenu

menu "Drivers"
    source "$srctree/drivers/Kconfig"
endmenu

menu "Qualcomm Input"
    config QCOM_KEYS
        bool "Enable Qualcomm key input"
        default y
        help
            Enable the debounced Qualcomm PON/GPIO key backend.  Volume Up
            maps to menu up, Volume Down maps to menu down, and Power maps to
            menu confirm.

    config QCOM_SPMI
        bool "Enable polled Qualcomm PMIC Arbiter SPMI reader"
        default n
        depends on QCOM_KEYS
        help
            Enable CrDK SPMI and PMIC GPIO input using controllers, bus IDs
            and slave IDs discovered from the runtime device tree.

    config QCOM_KEY_DEBOUNCE_SAMPLES
        int "Key debounce samples"
        range 1 32
        default 2
endmenu

menu "Touch input"
    config KSHIM_TOUCH
        bool "Enable DT-selected ST FTM5 touch input"
        default n
endmenu

menu "Multicore"
    config KSHIM_SMP
        bool "Enable PSCI workers"
        default n
    config KSHIM_SMP_SELFTEST
        bool "Run QEMU PSCI self-test and exit"
        depends on KSHIM_SMP
        select KSHIM_LVGL
        default n
    config KSHIM_SMP_WORKERS
        int "Maximum secondary workers"
        depends on KSHIM_SMP
        range 0 7
        default 3
endmenu

menu "Framebuffer and UI"
    config KSHIM_MENU_BASE_ANDROID
        bool "Describe the original base image as Android"
        default n
        help
            Board profiles with an Android base image may opt into Android
            wording. This does not change the image selection or boot path.

    config KSHIM_MENU_ENTRY_DETAILS
        bool "Show entry descriptions and separate navigation hints"
        default n
        help
            Keep the selected entry description in the right pane and show
            navigation hints in a separate footer on supported split layouts.

    config KSHIM_MENU_CHINESE
        bool "Use Simplified Chinese menu text"
        default n
        help
            Translate menu controls into Simplified Chinese. Entry names
            remain supplied by the manifest.

    config KSHIM_MENU_LANGUAGE_SWITCH
        bool "Runtime Chinese / English menu"
        default n

    config KSHIM_MENU_SESSION_SETTINGS
        bool "Session-only device and default-boot settings"
        default n
        help
            Offer device and default-boot settings in the boot menu. Any
            change made here applies only to the current boot session: the
            settings are not persistent, are never written to UFS or any
            other storage, and reset on the next boot.

    config KSHIM_MENU_SINGLE_LINUX
        bool "Show only actual Android and external Linux targets"
        depends on KSHIM_MENU_SESSION_SETTINGS
        default n

    config KSHIM_UI_ATLAS
        bool "Atlas pages (adapted from tc1911/kShimC4sheng)"
        depends on KSHIM_LVGL
        default n

    config KSHIM_MENU_POWER_ACTIONS
        bool "Enable firmware restart and power-off menu actions"
        default n
        help
            Add firmware restart and power-off actions to the boot menu.
            These actions do not require secondary CPU workers.

    config KSHIM_QEMU_PLATFORM
        bool "Enable QEMU test memory and framebuffer"
        default y
        help
            Permit virtual test windows. Console resources are always read
            from DT. Disable these test windows for physical boards.

    config KSHIM_FRAMEBUFFER
        bool "Enable validated continuous splash framebuffer UI"
        default y

    config KSHIM_FB_RENDER_ADDRESS
        depends on KSHIM_QEMU_PLATFORM
        hex "Framebuffer render address"
        default 0x0
        help
            Virtual test surface only. Physical platforms discover the live
            scanout layout from SDE and its DT reserved-memory region.

    config KSHIM_FB_WIDTH
        depends on KSHIM_QEMU_PLATFORM
        int "Framebuffer width"
        range 64 4096
        default 128

    config KSHIM_FB_HEIGHT
        depends on KSHIM_QEMU_PLATFORM
        int "Framebuffer height"
        range 48 4096
        default 64

    config KSHIM_FB_STRIDE
        depends on KSHIM_QEMU_PLATFORM
        int "Framebuffer stride in bytes"
        range 0 2147483647
        default 0
        help
            Zero selects the minimum stride for the selected pixel format.

    config KSHIM_FB_FORMAT
        depends on KSHIM_QEMU_PLATFORM
        int "Framebuffer format (1=mono LSB, 2=mono MSB, 3=gray8, 4=RGB565, 5/6=32-bit)"
        range 1 6
        default 1
        help
            LVGL renders color pixels and converts them to this target format.

    config KSHIM_LVGL
        bool "Enable LVGL boot menu"
        default y
        help
            Build the pinned LVGL boot menu with a selectable visual style.
            The default FLAT style retains the animated acrylic panel.
            Qualcomm Volume Up, Volume Down, and Power map to up, down,
            and confirm respectively. See docs/menu-styles.md.

    config KSHIM_PAD2PRO_MENU_PREVIEW
        bool "OPD2413 guarded diagnostic menu"
        depends on KSHIM_FRAMEBUFFER && KSHIM_LVGL
        default n
        help
            Show the menu until its Android timeout. Keys stay disabled
            unless the separate gated physical-key option is selected.
            Report UI/scanout status in the two existing diagnostic slots.
            If the UI cannot start, return to the Android default directly.

    config KSHIM_PAD2PRO_KEY_PROBE
        bool "OPD2413 single SPMI controller-version read"
        depends on KSHIM_PAD2PRO_MENU_PREVIEW && QCOM_KEYS && QCOM_SPMI
        default n
        help
            Validate the three captured PMIC key descriptors and controller
            regions, then read one version register with MMU enabled. Do not
            initialize the controller, submit a PMIC transaction or poll keys.
            Replace the preview's geometry report with the checkpoint result.

    config KSHIM_PAD2PRO_MENU_KEYS
        bool "OPD2413 gated physical keys in diagnostic menu"
        depends on KSHIM_PAD2PRO_KEY_PROBE
        default n
        help
            Require the measured v7 controller and exact key/resource layout,
            then probe PON and PMIC GPIO before enabling menu polling. Failed
            initial reads keep the timeout; a polling fault exits to Android.

    choice KSHIM_MENU_STYLE
        prompt "Boot menu style"
        depends on KSHIM_LVGL
        default KSHIM_MENU_STYLE_FLAT
        help
            Select the device boot menu appearance, not host menuconfig colors.
            Input and boot actions are shared. Only FLAT uses animated textures.
            Modern styles do not enable LVGL's built-in default theme.

        config KSHIM_MENU_STYLE_FLAT
            bool "FLAT - original dark acrylic"
        config KSHIM_MENU_STYLE_CLASSIC
            bool "CLASSIC - existing framed firmware menu"
        config KSHIM_MENU_STYLE_CARDS
            bool "CARDS - existing light rounded cards"
        config KSHIM_MENU_STYLE_TERMINAL
            bool "TERMINAL - existing green terminal look"
        config KSHIM_MENU_STYLE_MINIMAL
            bool "MINIMAL - existing quiet monochrome"
        config KSHIM_MENU_STYLE_HIGH_CONTRAST
            bool "HIGH_CONTRAST - existing black and white"

        source "$srctree/ui/styles/Kconfig"
    endchoice

    config KSHIM_UI_SCRATCH_BASE
        hex "UI scratch memory base (fallback)"
        default 0x0
        depends on KSHIM_LVGL

    config KSHIM_UI_SCRATCH_SIZE
        hex "UI scratch memory size (fallback)"
        default 0x0
        depends on KSHIM_LVGL
        help
            RAM outside the runtime slot for the inflated Noto Sans CJK font
            (about 840 KiB) and, for FLAT only, two background textures.
            Qualcomm boards use the display reservation past scanout.
            Without scratch the menu uses the existing Latin fallback font.

    config KSHIM_MENU_ENTRY_DURATION_MS
        int "Menu entrance animation duration (milliseconds)"
        range 0 2000
        default 360
        depends on KSHIM_LVGL
        help
            Zero presents the complete menu on its first frame. Other values
            fade and slide the panel into view over the selected duration.

    config KSHIM_UI_ROTATION_CCW
        int "UI pixel rotation into native scanout (degrees counterclockwise)"
        range 0 270
        default 0
        depends on KSHIM_LVGL
        help
            Use 0, 90, 180 or 270. Only the boot menu rotates; the hardware
            framebuffer dimensions, stride and Linux handoff stay native.
            At 90 degrees, logical (x,y) maps to native (y,height-1-x).

    config KSHIM_LVGL_BUFFER_BYTES
        int "LVGL partial render buffer size"
        range 128 1048576
        default 16384
        depends on KSHIM_LVGL
        help
            Bytes per partial color render buffer. Must hold one logical UI
            row after rotation. The Pad 2 Pro ext4 profile uses 32 rows
            (434176 bytes) per buffer at a logical width of 3392 pixels.

    config KSHIM_LVGL_HEAP_BYTES
        int "LVGL heap size"
        range 524288 8388608
        default 524288
        depends on KSHIM_LVGL
        help
            Heap for LVGL objects and rasterized glyph caches, separate from
            the general libc heap. The Pad 2 Pro ext4 profile uses 1 MiB.

endmenu

menu "Generic"
    config KSHIM_UEFI_TEST_MENU
        bool "Two entries that both launch the embedded UEFI FD"
        default n
        help
            Requires KSHIM_UEFI_PAYLOAD in CMake. The two names select the
            same payload, copied into its board-specific FD reservation.

    config KSHIM_MENU_ENTRY1
        string "First menu entry"
        default "Boot"
    config KSHIM_MENU_ENTRY2
        string "Second menu entry"
        default "Recovery"
    config KSHIM_UEFI_LOAD_ADDRESS
        hex "UEFI FD destination/entry address"
        default 0xFFC00000
        depends on KSHIM_UEFI_TEST_MENU
    config KSHIM_UEFI_MAX_SIZE
        hex "UEFI FD reserved size"
        default 0x400000
        depends on KSHIM_UEFI_TEST_MENU

    config ENABLE_BANNER
        bool "Enable Boot Banner"
        default y
        help
            Enable or disable the boot banner.
            If disabled, no banner will be displayed during boot.
    config BANNER
        string "Boot Banner"
        default "kShimC v$(VERSION) $(HOST_INFO) $(BUILD_TIME) \n"
        depends on ENABLE_BANNER

    config KSHIM_DEBUG_CONSOLE
        bool "Initialize the boot-FDT debug console (UART read/write and handoff quiesce)"
        default y
        help
            Controls boot-FDT UART initialization, read/write and handoff
            quiesce independently of log verbosity.

    choice
        bool
        prompt "Debug Level"
        default DEBUG_LEVEL_VERBOSE
        config DEBUG_LEVEL_NONE
            bool "None"
        config DEBUG_LEVEL_ERROR
            bool "Error"
        config DEBUG_LEVEL_WARNING
            bool "Warning"
        config DEBUG_LEVEL_INFO
            bool "Info"
        config DEBUG_LEVEL_VERBOSE
            bool "Verbose"
    endchoice

    config ASSERT_HALT
        bool "Halt on Assert Failure"
        default y
endmenu
```
